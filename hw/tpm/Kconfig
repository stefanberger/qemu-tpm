## hw/tpm/Kconfig
```kconfig
config TPM_TIS_I2C
    bool
    depends on TPM
    select TPM_BACKEND
    select I2C
    select TPM_TIS

config TPM_TIS_ISA
    bool
    depends on TPM && ISA_BUS
    select TPM_TIS

config TPM_TIS_SYSBUS
    bool
    depends on TPM
    select TPM_TIS

config TPM_TIS
    bool
    depends on TPM
    select TPM_BACKEND

config TPM_CRB
    bool
    depends on TPM && PC
    select TPM_BACKEND

config TPM_SPAPR
    bool
    default y
    depends on TPM && PSERIES
    select TPM_BACKEND

config TPM_VIRTIO
    bool
    default y
    depends on TPM
    select TPM_BACKEND

config TPM_VIRTIO_PCI
    bool
    default y
    depends on TPM && VIRTIO_PCI
    select TPM_BACKEND
```
